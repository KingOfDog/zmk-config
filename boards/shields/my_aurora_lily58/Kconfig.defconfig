## boards/shields/my_aurora_lily58/Kconfig.shield
```kconfig
# Copyright (c) 2022 The ZMK Contributors
# SPDX-License-Identifier: MIT

config SHIELD_MY_AURORA_LILY58_LEFT
    def_bool $(shields_list_contains,my_aurora_lily58_left)

config SHIELD_MY_AURORA_LILY58_RIGHT
    def_bool $(shields_list_contains,my_aurora_lily58_right)

config SHIELD_MY_AURORA_LILY58_DONGLE
    def_bool $(shields_list_contains,my_aurora_lily58_dongle)
```
